SECTIONS {
  .text.sorted : {
    /* LEAF & unsortable functions below */
    /* Unwind info 0x00000001 */
    *(.text.unlikely._Z3endv)
    *(.text.unlikely._exit)
    *(.text.unlikely._ZSt9terminatev)
    *(.text.unlikely.abort)
    *(.text.startup._ZN2ke5cacheIFvPvPSt9type_infoPFvS1_EEEENS_14instructions_tEPT_)
    *(.text.startup._sub_I_65535_0.0)
    *(.text.startup._GLOBAL__sub_I__ZNSt3pmr15memory_resourceD2Ev)
    *(.text.startup._GLOBAL__sub_I__ZSt20__throw_system_errori)
    *(.text._start)
    *(.text.deregister_tm_clones)
    *(.text.register_tm_clones)
    *(.text.__do_global_dtors_aux)
    *(.text.frame_dummy)
    *(.text._ZN10__cxxabiv119__terminate_handlerMUlvE_4_FUNEv)
    *(.text._ZN3hal26single_exception_allocator11do_allocateEjj)
    *(.text._ZNK3hal26single_exception_allocator11do_is_equalERKNSt3pmr15memory_resourceE)
    *(.text._ZZ19initialize_platformvENUlvE_4_FUNEv)
    *(.text._ZN3hal7stm32f14uart12driver_writeESt4spanIKhLj4294967295EE)
    *(.text._ZN3hal7stm32f112gpio_manager6outputD2Ev)
    *(.text._ZN3hal8cortex_m11dwt_counterD2Ev)
    *(.text._ZNK28single_block_memory_resourceILj256EE11do_is_equalERKNSt3pmr15memory_resourceE)
    *(.text._ZN3hal8cortex_m11dwt_counter13driver_uptimeEv)
    *(.text._ZN3hal8cortex_m11dwt_counter16driver_frequencyEv)
    *(.text._ZN3hal7stm32f14uart11driver_readESt4spanIhLj4294967295EE)
    *(.text._ZN3hal7stm32f14uart12driver_flushEv)
    *(.text._Z5pausev)
    *(.text._ZN2ke12unwind_frameERKNS_14instructions_tERNS_12cortex_m_cpuE)
    *(.text._ZN3hal26single_exception_allocator13do_deallocateEPvjj)
    *(.text._ZN28single_block_memory_resourceILj256EE11do_allocateEjj)
    *(.text.__tls_init.part.0)
    *(.text._ZN3hal26single_exception_allocatorD2Ev)
    *(.text._ZN28single_block_memory_resourceILj256EED2Ev)
    *(.text._ZN3hal26single_exception_allocatorD0Ev)
    *(.text._ZN3hal7stm32f112gpio_manager6outputD0Ev)
    *(.text._ZN3hal8cortex_m11dwt_counterD0Ev)
    *(.text._ZN28single_block_memory_resourceILj256EED0Ev)
    *(.text._ZN28single_block_memory_resourceILj256EE13do_deallocateEPvjj)
    *(.text._ZN3hal7stm32f14uart16driver_configureERKNS_6serial8settingsE)
    *(.text._ZN2ke16capture_cpu_coreERNS_12cortex_m_cpuE)
    *(.text._ZN2ke16restore_cpu_coreERNS_12cortex_m_cpuE)
    *(.text._ZN2ke15raise_exceptionERNS_23exception_control_blockE)
    *(.text.__wrap___cxa_free_exception)
    *(.text.__wrap___cxa_end_catch)
    *(.text.__wrap___cxa_begin_catch)
    *(.text.__wrap___cxa_end_cleanup)
    *(.text.__wrap__Unwind_Resume)
    *(.text.__wrap___aeabi_unwind_cpp_pr0)
    *(.text.__wrap___aeabi_unwind_cpp_pr1)
    *(.text.__wrap___gxx_personality_v0)
    *(.text.__aeabi_atexit)
    *(.text._ZNKSt9bad_alloc4whatEv)
    *(.text._ZNSt9bad_allocD2Ev)
    *(.text._ZNSt9bad_allocD0Ev)
    *(.text._ZNK10__cxxabiv117__class_type_info20__do_find_public_srcEiPKvPKS0_S2_)
    *(.text._ZN10__cxxabiv117__class_type_infoD2Ev)
    *(.text._ZN10__cxxabiv117__class_type_infoD0Ev)
    *(.text._ZNK10__cxxabiv117__class_type_info12__do_dyncastEiNS0_10__sub_kindEPKS0_PKvS3_S5_RNS0_16__dyncast_resultE)
    *(.text._ZNK10__cxxabiv117__class_type_info11__do_upcastEPKS0_PKvRNS0_15__upcast_resultE)
    *(.text._ZNK10__cxxabiv117__class_type_info10__do_catchEPKSt9type_infoPPvj)
    *(.text._ZdlPvj)
    *(.text._ZNSt9exceptionD2Ev)
    *(.text._ZN10__cxxabiv120__si_class_type_infoD2Ev)
    *(.text._ZN10__cxxabiv120__si_class_type_infoD0Ev)
    *(.text._ZNK10__cxxabiv120__si_class_type_info20__do_find_public_srcEiPKvPKNS_17__class_type_infoES2_)
    *(.text._ZNK10__cxxabiv120__si_class_type_info12__do_dyncastEiNS_17__class_type_info10__sub_kindEPKS1_PKvS4_S6_RNS1_16__dyncast_resultE)
    *(.text._ZNSt9type_infoD2Ev)
    *(.text._ZNKSt9type_info14__is_pointer_pEv)
    *(.text._ZNKSt9type_infoeqERKS_)
    *(.text._ZN10__cxxabiv121__vmi_class_type_infoD2Ev)
    *(.text._ZN10__cxxabiv121__vmi_class_type_infoD0Ev)
    *(.text._ZN9__gnu_cxx15__concat_size_tEPcjj)
    *(.text._ZNKSt3pmr12_GLOBAL__N_112newdel_res_t11do_is_equalERKNS_15memory_resourceE)
    *(.text._ZNSt3pmr12_GLOBAL__N_110null_res_t13do_deallocateEPvjj)
    *(.text._ZNSt3pmr12_GLOBAL__N_112newdel_res_tD2Ev)
    *(.text._ZNSt3pmr12_GLOBAL__N_110null_res_tD2Ev)
    *(.text._ZNSt3pmr12_GLOBAL__N_113constant_initINS0_12newdel_res_tEED2Ev)
    *(.text._ZNSt3pmr12_GLOBAL__N_113constant_initINS0_10null_res_tEED2Ev)
    *(.text._ZNSt3pmr12_GLOBAL__N_113constant_initINS0_14atomic_mem_resEED2Ev)
    *(.text._ZNSt3pmr12_GLOBAL__N_112newdel_res_tD0Ev)
    *(.text._ZNSt3pmr12_GLOBAL__N_110null_res_tD0Ev)
    *(.text._ZNSt3pmr12_GLOBAL__N_112newdel_res_t13do_deallocateEPvjj)
    *(.text._ZNSt3pmr12_GLOBAL__N_112newdel_res_t11do_allocateEjj)
    *(.text._ZNSt3pmr15memory_resourceD2Ev)
    *(.text._ZdlPv)
    *(.text._ZdlPvjSt11align_val_t)
    *(.text._ZNKSt11logic_error4whatEv)
    *(.text._ZNSt11logic_errorD2Ev)
    *(.text._ZNSt12length_errorD2Ev)
    *(.text._ZNSt12out_of_rangeD2Ev)
    *(.text._ZNSt11logic_errorD0Ev)
    *(.text._ZNSt12length_errorD0Ev)
    *(.text._ZNSt12out_of_rangeD0Ev)
    *(.text._ZNSs4_Rep10_M_destroyERKSaIcE)
    *(.text._ZNSt7__cxx1112basic_stringIcSt11char_traitsIcESaIcEE10_M_disposeEv)
    *(.text._ZNK12_GLOBAL__N_122generic_error_category4nameEv)
    *(.text._ZNK12_GLOBAL__N_122generic_error_category10equivalentEiRKSt15error_condition)
    *(.text._ZN12_GLOBAL__N_122generic_error_categoryD2Ev)
    *(.text._ZNK12_GLOBAL__N_121system_error_category4nameEv)
    *(.text._ZNK12_GLOBAL__N_121system_error_category23default_error_conditionEi)
    *(.text._ZN12_GLOBAL__N_121system_error_categoryD2Ev)
    *(.text._ZNKSt3_V214error_category23default_error_conditionEi)
    *(.text._ZNKSt3_V214error_category10equivalentERKSt10error_codei)
    *(.text._ZN12_GLOBAL__N_113constant_initINS_22generic_error_categoryEED2Ev)
    *(.text._ZN12_GLOBAL__N_113constant_initINS_21system_error_categoryEED2Ev)
    *(.text._ZN12_GLOBAL__N_122generic_error_categoryD0Ev)
    *(.text._ZN12_GLOBAL__N_121system_error_categoryD0Ev)
    *(.text._ZNK12_GLOBAL__N_121system_error_category10equivalentEiRKSt15error_condition)
    *(.text._ZdlPvSt11align_val_t)
    *(.text._ZSt15get_new_handlerv)
    *_arm_addsubdf3.o(.text*)
    *_arm_muldivdf3.o(.text*)
    *_arm_fixunsdfsi.o(.text*)
    *_arm_addsubsf3.o(.text*)
    *_arm_fixunssfsi.o(.text*)
    *_arm_muldivsf3.o(.text*)
    *_arm_cmpsf2.o(.text*)
    *_arm_unordsf2.o(.text*)
    *_aeabi_ldivmod.o(.text*)
    *(.text.__fixsfdi)
    *(.text.__fixunssfdi)
    *(.text.emutls_alloc)
    *(.text.__emutls_get_address)
    *strcmp.S.o(.text*)
    *(.text.memcpy)
    *(.text.memset)
    *strlen.S.o(.text*)
    *(.text.free)
    *(.text.__malloc_sbrk_aligned)
    *(.text.__malloc_grow_chunk)
    *(.text.malloc)
    *(.text.memalign)
    *(.text.__libc_init_array)
    *(.text.__retarget_lock_acquire_recursive)
    *(.text.__retarget_lock_release_recursive)
    *(.text.__cxa_atexit)
    *(.text.__call_exitprocs)
    *(.text._on_exit)
    *(.text.__xpg_strerror_r)
    *(.text.sbrk)
    *(.text.arm_halt_isr)
    *(.text.arm_ignore_isr)
    *(.text.__ultoa_invert)
    *(.text.skip_to_arg)
    *(.text.vfprintf)
    *(.text.mulShiftAll64)
    *(.text.div10)
    *(.text.__dtoa_engine)
    *(.text.__log10Pow2)
    *(.text.__log10Pow5)
    *(.text.__pow5bits)
    *(.text.__pow5Factor)
    *(.text.__double_computePow5)
    *(.text.__double_computeInvPow5)
    *(.text.__umul128)
    *(.text.__shiftright128)
    *(.text.roundf)
    *strcpy.S.o(.text*)
    *(.text.raise)
    *(.text._strerror_r)
    *(.text.strnlen)
    *(.text.__dtox_engine)
    *(.text.__file_str_put)
    *(.text.snprintf)
    *_aeabi_uldivmod.o(.text*)
    *(.text.__udivmoddi4)
    *_dvmd_tls.o(.text*)
    /* Unwind info 0x8001a8b0 */
    *(.text._Z8depth_02v.isra.0)
    *(.text._Z8depth_03v.isra.0)
    *(.text._Z8depth_04v.isra.0)
    *(.text._Z8depth_05v.isra.0)
    *(.text._Z8depth_06v.isra.0)
    *(.text._Z8depth_07v.isra.0)
    *(.text._Z8depth_08v.isra.0)
    *(.text._Z8depth_09v.isra.0)
    *(.text._Z8depth_10v.isra.0)
    *(.text._Z8depth_11v.isra.0)
    *(.text._Z8depth_12v.isra.0)
    *(.text._Z8depth_13v.isra.0)
    *(.text._Z8depth_14v.isra.0)
    *(.text._Z8depth_15v.isra.0)
    *(.text._Z8depth_16v.isra.0)
    *(.text._Z8depth_17v.isra.0)
    *(.text._Z8depth_18v.isra.0)
    *(.text._Z8depth_19v.isra.0)
    *(.text._Z8depth_20v.isra.0)
    *(.text._Z8depth_21v.isra.0)
    *(.text._Z8depth_22v.isra.0)
    *(.text._Z8depth_23v.isra.0)
    *(.text._Z8depth_24v.isra.0)
    *(.text._Z8depth_25v.isra.0)
    *(.text._Z8depth_26v.isra.0)
    *(.text._Z8depth_27v.isra.0)
    *(.text._Z8depth_28v.isra.0)
    *(.text._Z8depth_29v.isra.0)
    *(.text._Z8depth_30v.isra.0)
    *(.text._Z8depth_31v.isra.0)
    *(.text._Z8depth_32v.isra.0)
    *(.text._Z8depth_33v.isra.0)
    *(.text._Z8depth_34v.isra.0)
    *(.text._Z8depth_35v.isra.0)
    *(.text._Z8depth_36v.isra.0)
    *(.text._Z8depth_37v.isra.0)
    *(.text._Z8depth_38v.isra.0)
    *(.text._Z8depth_39v.isra.0)
    *(.text._Z8depth_40v.isra.0)
    *(.text._Z8depth_41v.isra.0)
    *(.text._Z8depth_42v.isra.0)
    *(.text._Z8depth_43v.isra.0)
    *(.text._Z8depth_44v.isra.0)
    *(.text._Z8depth_45v.isra.0)
    *(.text._Z8depth_46v.isra.0)
    *(.text._Z8depth_47v.isra.0)
    *(.text._Z8depth_48v.isra.0)
    *(.text._Z8depth_49v.isra.0)
    *(.text._Z8depth_50v.isra.0)
    *(.text._Z8depth_51v.isra.0)
    *(.text._Z8depth_52v.isra.0)
    *(.text._Z8depth_53v.isra.0)
    *(.text._Z8depth_54v.isra.0)
    *(.text._Z8depth_55v.isra.0)
    *(.text._Z8depth_56v.isra.0)
    *(.text._Z8depth_57v.isra.0)
    *(.text._Z8depth_58v.isra.0)
    *(.text._Z8depth_59v.isra.0)
    *(.text._Z8depth_60v.isra.0)
    *(.text._Z8depth_61v.isra.0)
    *(.text._Z8depth_62v.isra.0)
    *(.text._Z8depth_63v.isra.0)
    *(.text._Z8depth_64v.isra.0)
    *(.text._Z8depth_65v.isra.0)
    *(.text._Z8depth_66v.isra.0)
    *(.text._Z8depth_67v.isra.0)
    *(.text._Z8depth_68v.isra.0)
    *(.text._Z8depth_69v.isra.0)
    *(.text._Z8depth_70v.isra.0)
    /* Unwind info 0x7ffffe68 */
    *(.text.startup.main)
    /* Unwind info 0x8012afb0 */
    *(.text._ZNK10__cxxabiv121__vmi_class_type_info12__do_dyncastEiNS_17__class_type_info10__sub_kindEPKS1_PKvS4_S6_RNS1_16__dyncast_resultE)
    /* Unwind info 0x8002a9b0 */
    *(.text._ZN3hal7stm32f113configure_pinENS0_10pin_selectENS0_12pin_config_tE)
    /* Unwind info 0x80acb0b0 */
    *(.text._ZN3hal5delayERNS_12steady_clockENSt6chrono8durationIxSt5ratioILx1ELx1000000000EEEE.constprop.0)
    *(.text._ZNK10__cxxabiv120__si_class_type_info11__do_upcastEPKNS_17__class_type_infoEPKvRNS1_15__upcast_resultE)
    *(.text._ZN9__gnu_cxx15__snprintf_liteEPcjPKcSt9__va_list)
    /* Unwind info 0x80b108af */
    *(.text.__wrap___cxa_throw)
    /* Unwind info 0x8008afb0 */
    *(.text._ZNK10__cxxabiv121__vmi_class_type_info11__do_upcastEPKNS_17__class_type_infoEPKvRNS1_15__upcast_resultE)
    /* Unwind info 0x80a8b0b0 */
    *(.text.unlikely._ZN3hal7stm32f127throw_if_pin_is_unavailableENS0_10pin_selectE.part.0)
    *(.text.unlikely._ZN3hal7stm32f112_GLOBAL__N_124get_enable_register_infoENS0_10peripheralE.part.0)
    *(.text._ZNSt12length_errorC2EPKc)
    *(.text._ZNSt12out_of_rangeC2EPKc)
    *(.text._ZNSs4_Rep9_S_createEjjRKSaIcE)
    *(.text._Znwj)
    /* Unwind info 0x80aab0b0 */
    *(.text._ZN3hal7stm32f112gpio_manager6output16driver_configureERKNS_10output_pin8settingsE)
    *(.text.__wrap___cxa_allocate_exception)
    /* Unwind info 0x80b108a9 */
    *(.text.__wrap___cxa_rethrow)
    *(.text._ZnwjSt11align_val_t)
    /* Unwind info 0x7ffffdf4 */
    *(.text._ZN3hal7stm32f14uartD0Ev)
    /* Unwind info 0x7ffffe1c */
    *(.text._ZNK12_GLOBAL__N_122generic_error_category7messageB5cxx11Ei)
    /* Unwind info 0x7ffffdf0 */
    *(.text._ZN3hal7stm32f14uartD2Ev)
    /* Unwind info 0x8002afb0 */
    *(.text._ZNK10__cxxabiv121__vmi_class_type_info20__do_find_public_srcEiPKvPKNS_17__class_type_infoES2_)
    /* Unwind info 0x7ffffe40 */
    *(.text._ZNSt11logic_errorC2EPKc)
    /* Unwind info 0x8002abb0 */
    *(.text._ZNSt12__cow_stringC2EPKcj)
    /* Unwind info 0x7fffff48 */
    *(.text.unlikely._ZSt24__throw_out_of_range_fmtPKcz)
    /* Unwind info 0x80028400 */
    *(.text._Z8depth_01v.isra.0)
    /* Unwind info 0x8001aab0 */
    *(.text._ZNSt7__cxx1112basic_stringIcSt11char_traitsIcESaIcEE7reserveEj)
    /* Unwind info 0x7ffffe30 */
    *(.text._ZNSt7__cxx1112basic_stringIcSt11char_traitsIcESaIcEE9_M_createERjj)
    /* Unwind info 0x80971cab */
    *(.text.unlikely._ZN9__gnu_cxx26__throw_insufficient_spaceEPKcS1_)
    /* Unwind info 0x7ffffe0c */
    *(.text._ZN3hal7stm32f18power_onENS0_10peripheralE)
    /* Unwind info 0x7ffffdf8 */
    *(.text._ZN3hal7stm32f112gpio_manager6output12driver_levelEb)
    /* Unwind info 0x8003aab0 */
    *(.text._ZNK10__cxxabiv117__class_type_info11__do_upcastEPKS0_PPv)
    /* Unwind info 0x7ffffe28 */
    *(.text._ZNKSt3_V214error_category10_M_messageB5cxx11Ei)
    /* Unwind info 0x7fffff30 */
    *(.text.unlikely._ZSt19__throw_logic_errorPKc)
    /* Unwind info 0x7fffff3c */
    *(.text.unlikely._ZSt20__throw_length_errorPKc)
    /* Unwind info 0x7ffffdfc */
    *(.text._ZN3hal7stm32f112gpio_manager6output12driver_levelEv)
    /* Unwind info 0x7fffff2c */
    *(.text.unlikely._ZSt17__throw_bad_allocv)
    /* Unwind info 0x7ffffe38 */
    *(.text._ZN10__cxxabiv111__terminateEPFvvE)
    /* Unwind info 0x7ffffe54 */
    *(.text._ZNSt3pmr12_GLOBAL__N_110null_res_t11do_allocateEjj)
  }
}
INSERT BEFORE .text;
