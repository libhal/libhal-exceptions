SECTIONS
{
  .text :
  {
    KEEP(*(.text._ZN2ke12unwind_frameERKNS_14instructions_tERNS_12cortex_m_cpuE))
    KEEP(*(.text._ZNK10__cxxabiv121__vmi_class_type_info12__do_dyncastEiNS_17__class_type_info10__sub_kindEPKS1_PKvS4_S6_RNS1_16__dyncast_resultE))
    KEEP(*(.text._ZZN2ke12unwind_frameERKNS_14instructions_tERNS_12cortex_m_cpuEE10jump_table))
    KEEP(*(.text._ZN3hal5lpc4016configure_clocksERKNS0_10clock_treeE))
    KEEP(*(.text.__gnu_unwind_execute))
    KEEP(*(.text._Unwind_VRS_Pop))
    KEEP(*(.text.__gnu_unwind_pr_common))
    KEEP(*(.text._ZN2ke15raise_exceptionERNS_16exception_objectE))
    KEEP(*(.text._ZNK10__cxxabiv121__vmi_class_type_info11__do_upcastEPKNS_17__class_type_infoEPKvRNS1_15__upcast_resultE))
    KEEP(*(.text._ZN3hal5lpc4012_GLOBAL__N_19setup_pllERKNS0_10clock_treeERKNS1_13pll_registersEh))
    KEEP(*(.text._Z11applicationR13resource_list))
    KEEP(*(.text.unwind_phase2_forced))
    KEEP(*(.text._ZN2ke22near_point_guess_indexEm))
    KEEP(*(.text.__malloc_malloc))
    KEEP(*(.text.aligned_alloc))
    KEEP(*(.text.malloc))
    KEEP(*(.text.memalign))
    KEEP(*(.text.get_eit_entry))
    KEEP(*(.text._ZN2ke26get_index_entry_near_pointEm))
    KEEP(*(.text._ZNK10__cxxabiv121__vmi_class_type_info20__do_find_public_srcEiPKvPKNS_17__class_type_infoES2_))
    KEEP(*(.text._ZNK10__cxxabiv120__si_class_type_info12__do_dyncastEiNS_17__class_type_info10__sub_kindEPKS1_PKvS4_S6_RNS1_16__dyncast_resultE))
    KEEP(*(.text.__gnu_Unwind_Backtrace))
    KEEP(*(.text.__malloc_free))
    KEEP(*(.text.cfree))
    KEEP(*(.text.free))
    KEEP(*(.text.__wrap___cxa_throw))
    KEEP(*(.text._Z14funct_group6_9v))
    KEEP(*(.text._ZN3hal5lpc4012_GLOBAL__N_126enable_external_oscillatorEf))
    KEEP(*(.text.__wrap___cxa_rethrow))
    KEEP(*(.text.__gnu_Unwind_RaiseException))
    KEEP(*(.text._Z14funct_group0_5v))
    KEEP(*(.text._Z14funct_group5_5v))
    KEEP(*(.text._Z15funct_group1_11v))
    KEEP(*(.text._Z15funct_group2_23v))
    KEEP(*(.text._Z15funct_group3_47v))
    KEEP(*(.text._Z15funct_group4_95v))
    KEEP(*(.text._Z15funct_group6_11v))
    KEEP(*(.text._Z19initialize_platformv))
    KEEP(*(.text.search_EIT_table))
    KEEP(*(.text._ZN3hal5lpc407maximumEf))
    KEEP(*(.text.raise))
    KEEP(*(.text._start))
    KEEP(*(.text.restore_non_core_regs))
    KEEP(*(.text.__libc_init_array))
    KEEP(*(.text._Z14funct_group0_4v))
    KEEP(*(.text._ZN3hal5lpc4013get_frequencyENS0_10peripheralE))
    KEEP(*(.text._ZnwjSt11align_val_t))
    KEEP(*(.text._on_exit))
    KEEP(*(.text.__malloc_sbrk_aligned))
    KEEP(*(.text._GLOBAL__sub_I__ZNSt3pmr15memory_resourceD2Ev))
    KEEP(*(.text._ZNK10__cxxabiv117__class_type_info12__do_dyncastEiNS0_10__sub_kindEPKS0_PKvS3_S5_RNS0_16__dyncast_resultE))
    KEEP(*(.text.__gnu_Unwind_Resume))
    KEEP(*(.text.__malloc_grow_chunk))
    KEEP(*(.text.sbrk))
    KEEP(*(.text._ZN3hal8cortex_m11dwt_counterC1Ef))
    KEEP(*(.text._ZN3hal8cortex_m11dwt_counterC2Ef))
    KEEP(*(.text._Z14funct_group0_0v))
    KEEP(*(.text._Z14funct_group0_1v))
    KEEP(*(.text._Z14funct_group0_2v))
    KEEP(*(.text._Z14funct_group0_3v))
    KEEP(*(.text._Z14funct_group1_0v))
    KEEP(*(.text._Z14funct_group1_1v))
    KEEP(*(.text._Z14funct_group1_2v))
    KEEP(*(.text._Z14funct_group1_3v))
    KEEP(*(.text._Z14funct_group1_4v))
    KEEP(*(.text._Z14funct_group1_5v))
    KEEP(*(.text._Z14funct_group1_6v))
    KEEP(*(.text._Z14funct_group1_7v))
    KEEP(*(.text._Z14funct_group1_8v))
    KEEP(*(.text._Z14funct_group1_9v))
    KEEP(*(.text._Z14funct_group2_0v))
    KEEP(*(.text._Z14funct_group2_1v))
    KEEP(*(.text._Z14funct_group2_2v))
    KEEP(*(.text._Z14funct_group2_3v))
    KEEP(*(.text._Z14funct_group2_4v))
    KEEP(*(.text._Z14funct_group2_5v))
    KEEP(*(.text._Z14funct_group2_6v))
    KEEP(*(.text._Z14funct_group2_7v))
    KEEP(*(.text._Z14funct_group2_8v))
    KEEP(*(.text._Z14funct_group2_9v))
    KEEP(*(.text._Z14funct_group3_0v))
    KEEP(*(.text._Z14funct_group3_1v))
    KEEP(*(.text._Z14funct_group3_2v))
    KEEP(*(.text._Z14funct_group3_3v))
    KEEP(*(.text._Z14funct_group3_4v))
    KEEP(*(.text._Z14funct_group3_5v))
    KEEP(*(.text._Z14funct_group3_6v))
    KEEP(*(.text._Z14funct_group3_7v))
    KEEP(*(.text._Z14funct_group3_8v))
    KEEP(*(.text._Z14funct_group3_9v))
    KEEP(*(.text._Z14funct_group4_0v))
    KEEP(*(.text._Z14funct_group4_1v))
    KEEP(*(.text._Z14funct_group4_2v))
    KEEP(*(.text._Z14funct_group4_3v))
    KEEP(*(.text._Z14funct_group4_4v))
    KEEP(*(.text._Z14funct_group4_5v))
    KEEP(*(.text._Z14funct_group4_6v))
    KEEP(*(.text._Z14funct_group4_7v))
    KEEP(*(.text._Z14funct_group4_8v))
    KEEP(*(.text._Z14funct_group4_9v))
    KEEP(*(.text._Z14funct_group5_0v))
    KEEP(*(.text._Z14funct_group5_1v))
    KEEP(*(.text._Z14funct_group5_2v))
    KEEP(*(.text._Z14funct_group5_3v))
    KEEP(*(.text._Z14funct_group5_4v))
    KEEP(*(.text._Z14funct_group6_0v))
    KEEP(*(.text._Z14funct_group6_1v))
    KEEP(*(.text._Z14funct_group6_2v))
    KEEP(*(.text._Z14funct_group6_3v))
    KEEP(*(.text._Z14funct_group6_4v))
    KEEP(*(.text._Z14funct_group6_5v))
    KEEP(*(.text._Z14funct_group6_6v))
    KEEP(*(.text._Z14funct_group6_7v))
    KEEP(*(.text._Z14funct_group6_8v))
    KEEP(*(.text._Z15funct_group1_10v))
    KEEP(*(.text._Z15funct_group2_10v))
    KEEP(*(.text._Z15funct_group2_11v))
    KEEP(*(.text._Z15funct_group2_12v))
    KEEP(*(.text._Z15funct_group2_13v))
    KEEP(*(.text._Z15funct_group2_14v))
    KEEP(*(.text._Z15funct_group2_15v))
    KEEP(*(.text._Z15funct_group2_16v))
    KEEP(*(.text._Z15funct_group2_17v))
    KEEP(*(.text._Z15funct_group2_18v))
    KEEP(*(.text._Z15funct_group2_19v))
    KEEP(*(.text._Z15funct_group2_20v))
    KEEP(*(.text._Z15funct_group2_21v))
    KEEP(*(.text._Z15funct_group2_22v))
    KEEP(*(.text._Z15funct_group3_10v))
    KEEP(*(.text._Z15funct_group3_11v))
    KEEP(*(.text._Z15funct_group3_12v))
    KEEP(*(.text._Z15funct_group3_13v))
    KEEP(*(.text._Z15funct_group3_14v))
    KEEP(*(.text._Z15funct_group3_15v))
    KEEP(*(.text._Z15funct_group3_16v))
    KEEP(*(.text._Z15funct_group3_17v))
    KEEP(*(.text._Z15funct_group3_18v))
    KEEP(*(.text._Z15funct_group3_19v))
    KEEP(*(.text._Z15funct_group3_20v))
    KEEP(*(.text._Z15funct_group3_21v))
    KEEP(*(.text._Z15funct_group3_22v))
    KEEP(*(.text._Z15funct_group3_23v))
    KEEP(*(.text._Z15funct_group3_24v))
    KEEP(*(.text._Z15funct_group3_25v))
    KEEP(*(.text._Z15funct_group3_26v))
    KEEP(*(.text._Z15funct_group3_27v))
    KEEP(*(.text._Z15funct_group3_28v))
    KEEP(*(.text._Z15funct_group3_29v))
    KEEP(*(.text._Z15funct_group3_30v))
    KEEP(*(.text._Z15funct_group3_31v))
    KEEP(*(.text._Z15funct_group3_32v))
    KEEP(*(.text._Z15funct_group3_33v))
    KEEP(*(.text._Z15funct_group3_34v))
    KEEP(*(.text._Z15funct_group3_35v))
    KEEP(*(.text._Z15funct_group3_36v))
    KEEP(*(.text._Z15funct_group3_37v))
    KEEP(*(.text._Z15funct_group3_38v))
    KEEP(*(.text._Z15funct_group3_39v))
    KEEP(*(.text._Z15funct_group3_40v))
    KEEP(*(.text._Z15funct_group3_41v))
    KEEP(*(.text._Z15funct_group3_42v))
    KEEP(*(.text._Z15funct_group3_43v))
    KEEP(*(.text._Z15funct_group3_44v))
    KEEP(*(.text._Z15funct_group3_45v))
    KEEP(*(.text._Z15funct_group3_46v))
    KEEP(*(.text._Z15funct_group4_10v))
    KEEP(*(.text._Z15funct_group4_11v))
    KEEP(*(.text._Z15funct_group4_12v))
    KEEP(*(.text._Z15funct_group4_13v))
    KEEP(*(.text._Z15funct_group4_14v))
    KEEP(*(.text._Z15funct_group4_15v))
    KEEP(*(.text._Z15funct_group4_16v))
    KEEP(*(.text._Z15funct_group4_17v))
    KEEP(*(.text._Z15funct_group4_18v))
    KEEP(*(.text._Z15funct_group4_19v))
    KEEP(*(.text._Z15funct_group4_20v))
    KEEP(*(.text._Z15funct_group4_21v))
    KEEP(*(.text._Z15funct_group4_22v))
    KEEP(*(.text._Z15funct_group4_23v))
    KEEP(*(.text._Z15funct_group4_24v))
    KEEP(*(.text._Z15funct_group4_25v))
    KEEP(*(.text._Z15funct_group4_26v))
    KEEP(*(.text._Z15funct_group4_27v))
    KEEP(*(.text._Z15funct_group4_28v))
    KEEP(*(.text._Z15funct_group4_29v))
    KEEP(*(.text._Z15funct_group4_30v))
    KEEP(*(.text._Z15funct_group4_31v))
    KEEP(*(.text._Z15funct_group4_32v))
    KEEP(*(.text._Z15funct_group4_33v))
    KEEP(*(.text._Z15funct_group4_34v))
    KEEP(*(.text._Z15funct_group4_35v))
    KEEP(*(.text._Z15funct_group4_36v))
    KEEP(*(.text._Z15funct_group4_37v))
    KEEP(*(.text._Z15funct_group4_38v))
    KEEP(*(.text._Z15funct_group4_39v))
    KEEP(*(.text._Z15funct_group4_40v))
    KEEP(*(.text._Z15funct_group4_41v))
    KEEP(*(.text._Z15funct_group4_42v))
    KEEP(*(.text._Z15funct_group4_43v))
    KEEP(*(.text._Z15funct_group4_44v))
    KEEP(*(.text._Z15funct_group4_45v))
    KEEP(*(.text._Z15funct_group4_46v))
    KEEP(*(.text._Z15funct_group4_47v))
    KEEP(*(.text._Z15funct_group4_48v))
    KEEP(*(.text._Z15funct_group4_49v))
    KEEP(*(.text._Z15funct_group4_50v))
    KEEP(*(.text._Z15funct_group4_51v))
    KEEP(*(.text._Z15funct_group4_52v))
    KEEP(*(.text._Z15funct_group4_53v))
    KEEP(*(.text._Z15funct_group4_54v))
    KEEP(*(.text._Z15funct_group4_55v))
    KEEP(*(.text._Z15funct_group4_56v))
    KEEP(*(.text._Z15funct_group4_57v))
    KEEP(*(.text._Z15funct_group4_58v))
    KEEP(*(.text._Z15funct_group4_59v))
    KEEP(*(.text._Z15funct_group4_60v))
    KEEP(*(.text._Z15funct_group4_61v))
    KEEP(*(.text._Z15funct_group4_62v))
    KEEP(*(.text._Z15funct_group4_63v))
    KEEP(*(.text._Z15funct_group4_64v))
    KEEP(*(.text._Z15funct_group4_65v))
    KEEP(*(.text._Z15funct_group4_66v))
    KEEP(*(.text._Z15funct_group4_67v))
    KEEP(*(.text._Z15funct_group4_68v))
    KEEP(*(.text._Z15funct_group4_69v))
    KEEP(*(.text._Z15funct_group4_70v))
    KEEP(*(.text._Z15funct_group4_71v))
    KEEP(*(.text._Z15funct_group4_72v))
    KEEP(*(.text._Z15funct_group4_73v))
    KEEP(*(.text._Z15funct_group4_74v))
    KEEP(*(.text._Z15funct_group4_75v))
    KEEP(*(.text._Z15funct_group4_76v))
    KEEP(*(.text._Z15funct_group4_77v))
    KEEP(*(.text._Z15funct_group4_78v))
    KEEP(*(.text._Z15funct_group4_79v))
    KEEP(*(.text._Z15funct_group4_80v))
    KEEP(*(.text._Z15funct_group4_81v))
    KEEP(*(.text._Z15funct_group4_82v))
    KEEP(*(.text._Z15funct_group4_83v))
    KEEP(*(.text._Z15funct_group4_84v))
    KEEP(*(.text._Z15funct_group4_85v))
    KEEP(*(.text._Z15funct_group4_86v))
    KEEP(*(.text._Z15funct_group4_87v))
    KEEP(*(.text._Z15funct_group4_88v))
    KEEP(*(.text._Z15funct_group4_89v))
    KEEP(*(.text._Z15funct_group4_90v))
    KEEP(*(.text._Z15funct_group4_91v))
    KEEP(*(.text._Z15funct_group4_92v))
    KEEP(*(.text._Z15funct_group4_93v))
    KEEP(*(.text._Z15funct_group4_94v))
    KEEP(*(.text._Z15funct_group6_10v))
    KEEP(*(.text._ZNK10__cxxabiv120__si_class_type_info20__do_find_public_srcEiPKvPKNS_17__class_type_infoES2_))
    KEEP(*(.text.__cxa_guard_acquire))
    KEEP(*(.text.next_unwind_byte))
    KEEP(*(.text.unwind_phase2))
    KEEP(*(.text._ZN2ke13get_rtti_typeEPKv))
    KEEP(*(.text._ZNK10__cxxabiv117__class_type_info11__do_upcastEPKS0_PPv))
    KEEP(*(.text._Unwind_VRS_Get))
    KEEP(*(.text._Unwind_VRS_Set))
    KEEP(*(.text._Z41__static_initialization_and_destruction_0ii))
    KEEP(*(.text._ZNKSt9type_info7__equalERKS_))
    KEEP(*(.text._ZNKSt9type_infoeqERKS_))
    KEEP(*(.text._ZTVN10__cxxabiv117__class_type_infoE))
    KEEP(*(.text._ZTVN10__cxxabiv120__si_class_type_infoE))
    KEEP(*(.text._ZTVN10__cxxabiv121__vmi_class_type_infoE))
    KEEP(*(.text._ZN2ke15get_index_entryEm))
    KEEP(*(.text._ZNK10__cxxabiv117__class_type_info10__do_catchEPKSt9type_infoPPvj))
    KEEP(*(.text._ZNK10__cxxabiv120__si_class_type_info11__do_upcastEPKNS_17__class_type_infoEPKvRNS1_15__upcast_resultE))
    KEEP(*(.text.__gnu_unwind_get_pr_addr))
    KEEP(*(.text.__popcountsi2))
    KEEP(*(.text._ZTSN10__cxxabiv121__vmi_class_type_infoE))
    KEEP(*(.text._ZTSNSt3pmr12_GLOBAL__N_112newdel_res_tE))
    KEEP(*(.text._ZTSN10__cxxabiv120__si_class_type_infoE))
    KEEP(*(.text._ZTSNSt3pmr12_GLOBAL__N_110null_res_tE))
    KEEP(*(.text.__wrap___cxa_free_exception))
    KEEP(*(.text._ZTSN9__gnu_cxx20recursive_init_errorE))
    KEEP(*(.text._Unwind_Backtrace))
    KEEP(*(.text._Unwind_ForcedUnwind))
    KEEP(*(.text._Unwind_RaiseException))
    KEEP(*(.text._Unwind_Resume))
    KEEP(*(.text._Unwind_Resume_or_Rethrow))
    KEEP(*(.text._ZTSN10__cxxabiv117__class_type_infoE))
    KEEP(*(.text.___Unwind_Backtrace))
    KEEP(*(.text.___Unwind_ForcedUnwind))
    KEEP(*(.text.___Unwind_RaiseException))
    KEEP(*(.text.___Unwind_Resume))
    KEEP(*(.text.___Unwind_Resume_or_Rethrow))
    KEEP(*(.text.main))
    KEEP(*(.text._ZN3hal8cortex_m11dwt_counter13driver_uptimeEv))
    KEEP(*(.text._ZSt17__throw_bad_allocv))
    KEEP(*(.text.__wrap___cxa_end_catch))
    KEEP(*(.text._ZN10__cxxabiv117__class_type_infoD0Ev))
    KEEP(*(.text._ZN10__cxxabiv120__si_class_type_infoD0Ev))
    KEEP(*(.text._ZN10__cxxabiv121__vmi_class_type_infoD0Ev))
    KEEP(*(.text._ZN9__gnu_cxx20recursive_init_errorD0Ev))
    KEEP(*(.text._ZNSt9bad_allocD0Ev))
    KEEP(*(.text._ZTVNSt3pmr12_GLOBAL__N_110null_res_tE))
    KEEP(*(.text._ZTVNSt3pmr12_GLOBAL__N_112newdel_res_tE))
    KEEP(*(.text.__aeabi_memcpy))
    KEEP(*(.text.__aeabi_memcpy4))
    KEEP(*(.text.__aeabi_memcpy8))
    KEEP(*(.text.__wrap___cxa_end_cleanup))
    KEEP(*(.text.memcpy))
    KEEP(*(.text._Unwind_GetGR))
    KEEP(*(.text._ZNK10__cxxabiv117__class_type_info11__do_upcastEPKS0_PKvRNS0_15__upcast_resultE))
    KEEP(*(.text._ZTSNSt3pmr15memory_resourceE))
    KEEP(*(.text._GLOBAL__sub_I___cxa_get_globals_fast))
    KEEP(*(.text._Unwind_SetGR))
    KEEP(*(.text._ZN2ke23get_arm_exception_indexEv))
    KEEP(*(.text._ZTVN3hal8cortex_m11dwt_counterE))
    KEEP(*(.text.__restore_core_regs))
    KEEP(*(.text.restore_core_regs))
    KEEP(*(.text.__wrap___cxa_allocate_exception))
    KEEP(*(.text._ZN10__cxxabiv117__class_type_infoD1Ev))
    KEEP(*(.text._ZN10__cxxabiv117__class_type_infoD2Ev))
    KEEP(*(.text._ZN10__cxxabiv120__si_class_type_infoD1Ev))
    KEEP(*(.text._ZN10__cxxabiv120__si_class_type_infoD2Ev))
    KEEP(*(.text._ZN10__cxxabiv121__vmi_class_type_infoD1Ev))
    KEEP(*(.text._ZN10__cxxabiv121__vmi_class_type_infoD2Ev))
    KEEP(*(.text._ZN3hal13set_terminateEPFvvE))
    KEEP(*(.text._ZN3hal5lpc4025using_external_oscillatorEv))
    KEEP(*(.text._ZN9__gnu_cxx20recursive_init_errorD1Ev))
    KEEP(*(.text._ZN9__gnu_cxx20recursive_init_errorD2Ev))
    KEEP(*(.text._ZNSt9bad_allocD1Ev))
    KEEP(*(.text._ZNSt9bad_allocD2Ev))
    KEEP(*(.text._ZSt9terminatev))
    KEEP(*(.text._ZTVN9__gnu_cxx20recursive_init_errorE))
    KEEP(*(.text._ZTVSt9bad_alloc))
    KEEP(*(.text._ZTVSt9exception))
    KEEP(*(.text.strcmp))
    KEEP(*(.text.__gnu_Unwind_Resume_or_Rethrow))
    KEEP(*(.text.selfrel_offset31))
    KEEP(*(.text._ZN10__cxxabiv111__terminateEPFvvE))
    KEEP(*(.text._ZSt15get_new_handlerv))
    KEEP(*(.text.__gnu_Unwind_ForcedUnwind))
    KEEP(*(.text.memset))
    KEEP(*(.text._GLOBAL__sub_I__ZN10__cxxabiv119__terminate_handlerE))
    KEEP(*(.text._ZNSt3pmr12_GLOBAL__N_110null_res_tD0Ev))
    KEEP(*(.text._ZNSt3pmr12_GLOBAL__N_112newdel_res_tD0Ev))
    KEEP(*(.text._ZNSt9exceptionD0Ev))
    KEEP(*(.text.abort))
    KEEP(*(.text._ZTSSt9bad_alloc))
    KEEP(*(.text._ZTSSt9exception))
    KEEP(*(.text._ZTSSt9type_info))
    KEEP(*(.text._ZN2ke17current_exceptionEv))
    KEEP(*(.text._ZN3hal13get_terminateEv))
    KEEP(*(.text._ZN3hal23get_exception_allocatorEv))
    KEEP(*(.text._ZN3hal23set_exception_allocatorEPNSt3pmr15memory_resourceE))
    KEEP(*(.text._ZN9__gnu_cxx20recursive_init_errorC1Ev))
    KEEP(*(.text._ZN9__gnu_cxx20recursive_init_errorC2Ev))
    KEEP(*(.text._ZNK10__cxxabiv117__class_type_info20__do_find_public_srcEiPKvPKS0_S2_))
    KEEP(*(.text._ZTIN10__cxxabiv117__class_type_infoE))
    KEEP(*(.text._ZTIN10__cxxabiv120__si_class_type_infoE))
    KEEP(*(.text._ZTIN10__cxxabiv121__vmi_class_type_infoE))
    KEEP(*(.text._ZTIN9__gnu_cxx20recursive_init_errorE))
    KEEP(*(.text._ZTINSt3pmr12_GLOBAL__N_110null_res_tE))
    KEEP(*(.text._ZTINSt3pmr12_GLOBAL__N_112newdel_res_tE))
    KEEP(*(.text._ZTISt9bad_alloc))
    KEEP(*(.text._Unwind_decode_typeinfo_ptr.constprop.0))
    KEEP(*(.text._ZNKSt3pmr12_GLOBAL__N_110null_res_t11do_is_equalERKNS_15memory_resourceE))
    KEEP(*(.text._ZNKSt3pmr12_GLOBAL__N_112newdel_res_t11do_is_equalERKNS_15memory_resourceE))
    KEEP(*(.text._ZNSt3pmr12_GLOBAL__N_112newdel_res_t13do_deallocateEPvjj))
    KEEP(*(.text.__aeabi_atexit))
    KEEP(*(.text.__cxa_atexit))
    KEEP(*(.text.__wrap___cxa_begin_catch))
    KEEP(*(.text._ZGTtNKSt9exception4whatEv))
    KEEP(*(.text._ZN3hal5lpc4010oscillatorL15external_enableE))
    KEEP(*(.text._ZNKSt9bad_alloc4whatEv))
    KEEP(*(.text._ZNKSt9exception4whatEv))
    KEEP(*(.text._ZNSt3pmr12_GLOBAL__N_112newdel_res_t11do_allocateEjj))
    KEEP(*(.text._ZTINSt3pmr15memory_resourceE))
    KEEP(*(.text._ZTISt9exception))
    KEEP(*(.text._ZTISt9type_info))
    KEEP(*(.text._ZN3hal8cortex_m11dwt_counter16driver_frequencyEv))
    KEEP(*(.text._ZN3hal8cortex_m11dwt_counter22register_cpu_frequencyEf))
    KEEP(*(.text._ZNSt3pmr12_GLOBAL__N_110null_res_t11do_allocateEjj))
    KEEP(*(.text._ZdlPvjSt11align_val_t))
    KEEP(*(.text.__aeabi_unwind_cpp_pr0))
    KEEP(*(.text.__cxa_guard_abort))
    KEEP(*(.text.__cxa_guard_release))
    KEEP(*(.text.__wrap___cxa_call_unexpected))
    KEEP(*(.text._exit))
    KEEP(*(.text._ZN2ke22extract_si_parent_infoEPKv))
    KEEP(*(.text._ZNKSt9type_info14__is_pointer_pEv))
    KEEP(*(.text._ZNKSt9type_info15__is_function_pEv))
    KEEP(*(.text._ZdlPv))
    KEEP(*(.text._ZdlPvSt11align_val_t))
    KEEP(*(.text._ZdlPvj))
    KEEP(*(.text._Unwind_DebugHook))
    KEEP(*(.text._Z17terminate_handlerv))
    KEEP(*(.text._ZN12_GLOBAL__N_113constant_initD1Ev))
    KEEP(*(.text._ZN12_GLOBAL__N_113constant_initD2Ev))
    KEEP(*(.text._ZN2ke6get_luEPv))
    KEEP(*(.text._ZN2ke8get_su16EPv))
    KEEP(*(.text._ZNSt3pmr12_GLOBAL__N_110null_res_t13do_deallocateEPvjj))
    KEEP(*(.text._ZNSt3pmr12_GLOBAL__N_110null_res_tD1Ev))
    KEEP(*(.text._ZNSt3pmr12_GLOBAL__N_110null_res_tD2Ev))
    KEEP(*(.text._ZNSt3pmr12_GLOBAL__N_112newdel_res_tD1Ev))
    KEEP(*(.text._ZNSt3pmr12_GLOBAL__N_112newdel_res_tD2Ev))
    KEEP(*(.text._ZNSt3pmr12_GLOBAL__N_113constant_initINS0_10null_res_tEED1Ev))
    KEEP(*(.text._ZNSt3pmr12_GLOBAL__N_113constant_initINS0_10null_res_tEED2Ev))
    KEEP(*(.text._ZNSt3pmr12_GLOBAL__N_113constant_initINS0_12newdel_res_tEED1Ev))
    KEEP(*(.text._ZNSt3pmr12_GLOBAL__N_113constant_initINS0_12newdel_res_tEED2Ev))
    KEEP(*(.text._ZNSt3pmr12_GLOBAL__N_113constant_initISt6atomicIPNS_15memory_resourceEEED1Ev))
    KEEP(*(.text._ZNSt3pmr12_GLOBAL__N_113constant_initISt6atomicIPNS_15memory_resourceEEED2Ev))
    KEEP(*(.text._ZNSt3pmr15memory_resourceD1Ev))
    KEEP(*(.text._ZNSt3pmr15memory_resourceD2Ev))
    KEEP(*(.text._ZNSt9exceptionD1Ev))
    KEEP(*(.text._ZNSt9exceptionD2Ev))
    KEEP(*(.text._ZNSt9type_infoD1Ev))
    KEEP(*(.text._ZNSt9type_infoD2Ev))
    KEEP(*(.text.__retarget_lock_acquire_recursive))
    KEEP(*(.text.__retarget_lock_release_recursive))
    KEEP(*(.text.__wrap___aeabi_unwind_cpp_pr0))
    KEEP(*(.text.__wrap___gnu_unwind_pr_common))
    KEEP(*(.text.__wrap___gxx_personality_v0))
    KEEP(*(.text.__wrap__sig_func))
    KEEP(*(.text.__wrap_deregister_tm_clones))
    KEEP(*(.text.__wrap_register_tm_clones))
    KEEP(*(.text.arm_halt_isr))
    KEEP(*(.text.arm_ignore_isr))
    KEEP(*(.text.__do_global_dtors_aux))
    KEEP(*(.text.__do_global_dtors_aux_fini_array_entry))
    KEEP(*(.text.__frame_dummy_init_array_entry))
    KEEP(*(.text.__gnu_Unwind_Restore_VFP))
    KEEP(*(.text.__gnu_Unwind_Restore_VFP_D))
    KEEP(*(.text.__gnu_Unwind_Restore_VFP_D_16_to_31))
    KEEP(*(.text.__gnu_Unwind_Restore_WMMXC))
    KEEP(*(.text.__gnu_Unwind_Restore_WMMXD))
    KEEP(*(.text.__gnu_Unwind_Save_VFP))
    KEEP(*(.text.__gnu_Unwind_Save_VFP_D))
    KEEP(*(.text.__gnu_Unwind_Save_VFP_D_16_to_31))
    KEEP(*(.text.__gnu_Unwind_Save_WMMXC))
    KEEP(*(.text.__gnu_Unwind_Save_WMMXD))
    KEEP(*(.text.__init_array_end))
    KEEP(*(.text.__init_array_start))
    KEEP(*(.text.__preinit_array_end))
    KEEP(*(.text.__preinit_array_start))
    KEEP(*(.text.__text_end))
    KEEP(*(.text.deregister_tm_clones))
    KEEP(*(.text.frame_dummy))
    KEEP(*(.text.register_tm_clones))
    *(.text*)
    *(.rodata*)
  } > FLASH
}